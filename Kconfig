## Kconfig
```kconfig
# SPDX-License-Identifier: MIT

config BOARD_HOLYIOT_NRF52840_DONGLE
	bool

# Add any additional custom Kconfig options here
```

## boards/arm/holyiot_nrf52840_dongle/Kconfig.board
```kconfig
# SPDX-License-Identifier: MIT

config BOARD_HOLYIOT_NRF52840_DONGLE
	bool "HolyIOT nRF52840 USB Dongle"
	depends on SOC_NRF52840_QIAA
```

## boards/arm/holyiot_nrf52840_dongle/Kconfig.defconfig
```kconfig
# SPDX-License-Identifier: MIT

if BOARD_HOLYIOT_NRF52840_DONGLE

config BOARD
	default "holyiot_nrf52840_dongle"

config BT_CTLR
	default BT

# Standard nRF52840 features
if BOARD_HOLYIOT_NRF52840_DONGLE

config NORDIC_QSPI_NOR
	default y if SPI

endif # BOARD_HOLYIOT_NRF52840_DONGLE

endif # BOARD_HOLYIOT_NRF52840_DONGLE
```
